## ESP_DEMO/main/Kconfig.projbuild
```kconfig
# put here your custom config value
menu "Example Configuration"
config ESP_WIFI_SSID
    string "WiFi SSID"
    default "VerticalInv"
    help
	SSID (network name) for the example to connect to.

config ESP_WIFI_PASSWORD
    string "WiFi Password"
    default "@VIL@123"
    help
	WiFi password (WPA or WPA2) for the example to use.
endmenu
```
